## main/Kconfig.projbuild
```kconfig
menu "esp-drone"
	choice 
		prompt "Hardward gpio version"
		default ESP_DRONE_HW_VER_1
		
		config ESP_DRONE_HW_VER_1
			bool "Version 1"
		
		config ESP_DRONE_HW_VER_2
			bool "Version 2"
	endchoice

	choice
		prompt  "Angle PID Algorithm"
		default  ANGLE_PID_ALGORITHM_EULER_PID

		config ANGLE_PID_ALGORITHM_EULER_PID
			bool "Euler PID"

		config  ANGLE_PID_ALGORITHM_Q_PID
			bool "Quaternion PID"
	endchoice
endmenu
```
